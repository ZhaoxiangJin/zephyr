/*
 * Copyright 2025 NXP
 *
 * SPDX-License-Identifier: Apache-2.0
 */

/dts-v1/;

#include "mcx_n5xx_evk.dtsi"
#include <nxp/mcx/nxp_mcxn54x_cm33_cpu0.dtsi>
#include "mcx_nx4x_evk_cpu0.dtsi"

/ {
	model = "NXP MCX-N5XX-EVK board";
};
