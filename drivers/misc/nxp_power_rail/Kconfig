## drivers/misc/nxp_power_rail/Kconfig
```kconfig
# Copyright 2026 NXP
# SPDX-License-Identifier: Apache-2.0

config NXP_POWER_RAIL
	bool
	help
	  Selected by concrete NXP power-rail controller drivers (PMC,
	  SLEEPCON).

config NXP_PMC_POWER_RAIL
	bool "NXP PMC power-rail controller driver"
	default y
	depends on DT_HAS_NXP_PMC_POWER_RAIL_CONTROLLER_ENABLED
	select NXP_POWER_RAIL
	help
	  Enable the NXP PMC power-rail controller driver. The driver
	  operates on the ``PDRUNCFGn`` staging registers and commits
	  changes via ``CTRL.APPLYCFG``.

config NXP_SLEEPCON_POWER_RAIL
	bool "NXP SLEEPCON power-rail controller driver"
	default y
	depends on DT_HAS_NXP_SLEEPCON_POWER_RAIL_CONTROLLER_ENABLED
	select NXP_POWER_RAIL
	help
	  Enable the NXP SLEEPCON power-rail controller driver. The driver
	  operates on the single ``RUNCFG`` register through its
	  write-to-set / write-to-clear aliases.

if NXP_POWER_RAIL

config NXP_POWER_RAIL_INIT_PRIORITY
	int "NXP power-rail controller init priority"
	default 35
	help
	  Initialization priority for the power-rail controllers. Must run
	  earlier than any peripheral driver that consumes a power rail.

endif # NXP_POWER_RAIL
```

## dts/bindings/cpu/enable-method/nxp,mcxn-cpu1.yaml
```yaml
# Copyright 2026 NXP
# SPDX-License-Identifier: Apache-2.0

title: NXP MCXN (MCXNx4x) secondary CPU enable-method

description: |
  Enable-method for the secondary Cortex-M33 (CPU1) on NXP MCXNx4x dual-core
  SoCs (e.g. MCXN947, MCXN547).

  On these SoCs the primary core (CPU0) launches CPU1 by pointing the
  SYSCON->CPBOOT register at the flash region CPU1 executes from and then
  releasing CPU1 from reset. CPU1 executes in place (XIP) from that flash
  region, so only an execution-memory phandle is required; no separate
  load/copy step is performed.

  This binding replaces the ad-hoc "zephyr,code-cpu1-partition" /chosen
  property previously used to convey CPU1's boot address to CPU0.

compatible: "nxp,mcxn-cpu1"

include: cpu.yaml

properties:
  enable-method:
    const: "nxp,mcxn-cpu1"

  execution-memory:
    type: phandle
    required: true
    description: |
      Phandle to the flash memory region or partition CPU1 boots and executes
      from. Its base address is programmed into SYSCON->CPBOOT.
```

## dts/bindings/cpu_freq/zephyr,cpu-freq-thermal-cap.yaml
```yaml
# Copyright 2026 NXP
# SPDX-License-Identifier: Apache-2.0

description: |
  CPU frequency thermal cap

compatible: "zephyr,cpu-freq-thermal-cap"

properties:
  sensor:
    type: phandle
    required: true
    description: |
      Temperature sensor used to compute the CPU frequency thermal cap.

  sensor-channel:
    type: string
    default: "die-temp"
    enum:
      - "die-temp"
      - "ambient-temp"
    description: |
      Sensor channel used for temperature samples.

  polling-delay-ms:
    type: int
    default: 1000
    description: |
      Polling interval in milliseconds while no thermal trip is active.

  passive-polling-delay-ms:
    type: int
    default: 100
    description: |
      Polling interval in milliseconds while one or more thermal trips are active.

  fail-safe-pstate:
    type: phandle
    description: |
      P-state applied as the maximum allowed P-state after repeated sensor failures.
      If omitted, the lowest-performance P-state is used.

child-binding:
  description: |
    CPU frequency thermal trip point

  properties:
    temperature-millicelsius:
      type: int
      required: true
      description: |
        Temperature threshold in millicelsius. When this threshold is reached, the
        trip becomes active and constrains CPU frequency to cap-pstate or lower.

    hysteresis-millicelsius:
      type: int
      default: 0
      description: |
        Hysteresis in millicelsius. An active trip is released when the measured
        temperature falls to temperature-millicelsius minus this value.

    cap-pstate:
      type: phandle
      required: true
      description: |
        Highest-performance P-state allowed while this trip is active.
```

## dts/bindings/power/nxp,pmc-power-rail-controller.yaml
```yaml
# Copyright 2026 NXP
# SPDX-License-Identifier: Apache-2.0

description: |
  NXP PMC (Power Management Controller) power-rail controller.

  The PMC owns the SoC power-switch matrix: array / periphery power
  rails for on-chip peripherals (APD / PPD), voltage monitors, body
  bias generators, DSR retention enables and power-mode control for
  the integrated DCDC / LDO regulators.

  A contiguous set of 32-bit ``PDRUNCFGn`` registers holds the enable
  bits. Writing 1 asserts power-down for the selected rail; writing 0
  releases it. ``PDRUNCFGn`` are staging registers: the hardware only
  samples them when software writes ``CTRL.APPLYCFG`` and waits for
  ``STATUS.BUSY`` to clear.

  Consumers request the rails they need through the ``nxp,power-rails``
  phandle-array property. Each specifier is a single controller-local
  identifier that
  linearly addresses the full PDRUNCFGn array as
  ``pdruncfg_index * 32 + bit_within_register``. Named constants for the
  SoC in use are provided in
  ``include/zephyr/dt-bindings/power/nxp_rt7xx_pmc_power.h``.

compatible: "nxp,pmc-power-rail-controller"

include: base.yaml

examples: |
    pmc0: pmc@20f000 {
      compatible = "nxp,pmc-power-rail-controller";
      reg = <0x20f000 0x1000>;
      #power-rail-cells = <1>;
    };

    &lcdif {
      nxp,power-rails = <&pmc0 NXP_RT7XX_PMC_APD_LCDIF>,
                        <&pmc0 NXP_RT7XX_PMC_PPD_LCDIF>;
    };

properties:
  reg:
    required: true

  "#power-rail-cells":
    type: int
    const: 1

power-rail-cells:
  - id
```

## dts/bindings/power/nxp,sleepcon-power-rail-controller.yaml
```yaml
# Copyright 2026 NXP
# SPDX-License-Identifier: Apache-2.0

description: |
  NXP SLEEPCON power-rail controller.

  SLEEPCON manages the clock-tree side of the low-power architecture:
  domain main-clock shut-off bits, on-chip oscillator and PLL enables
  (FRO, XTAL, LPOSC, ADC) and similar analog/clock-gate controls. These
  bits live in a single 32-bit ``RUNCFG`` register that is shadowed by
  write-1-to-set and write-1-to-clear alias registers (``RUNCFG_SET`` /
  ``RUNCFG_CLR``). Writes take effect immediately - no commit step is
  required.

  Consumers request the rails they need through the ``nxp,power-rails``
  phandle-array property. Each specifier is a single controller-local
  identifier, interpreted as a bit position in ``RUNCFG`` (0..31).
  Named constants for the SoC in use are provided in
  ``include/zephyr/dt-bindings/power/nxp_rt7xx_sleepcon_power.h``.

compatible: "nxp,sleepcon-power-rail-controller"

include: base.yaml

examples: |
    sleepcon0: sleepcon@3000 {
      compatible = "nxp,sleepcon-power-rail-controller";
      reg = <0x3000 0x1000>;
      #power-rail-cells = <1>;
    };

    &lcdif {
      nxp,power-rails = <&sleepcon0 NXP_RT7XX_SLEEPCON_SHUT_MEDIA_MAINCLK>;
    };

properties:
  reg:
    required: true

  "#power-rail-cells":
    type: int
    const: 1

power-rail-cells:
  - id
```

## dts/bindings/wuc/nxp,sleepcon-wuc.yaml
```yaml
# SPDX-FileCopyrightText: Copyright 2026 NXP
# SPDX-License-Identifier: Apache-2.0

description: |
  NXP SLEEPCON (Sleep Controller) acting as a Wakeup Controller (WUC).

  The SLEEPCON WAKEUPEN registers gate which peripheral interrupts are
  allowed to wake a CPU from low-power modes. A wakeup source is identified
  by its NVIC interrupt number: enabling source N sets bit (N % 32) of
  the WAKEUPEN(N / 32) register. This maps 1:1 onto the "id" cell consumed
  through "wakeup-ctrls" properties, so the id of a source equals the
  interrupt number of the module that owns it (e.g. the RTC alarm interrupt,
  a GPIO port interrupt, an MU interrupt).

  Each CPU domain owns its own SLEEPCON instance: SLEEPCON0 (VDD2_COMP) serves
  CPU0 and SLEEPCON1 (VDD1_SENSE) serves CPU1.

  Note: SLEEPCON only masks which interrupts may wake the core. Completing the
  peripheral low-power handshake (required by some modules to actually generate
  a wakeup in Deep Sleep) and the Deep Sleep entry/exit sequence itself are the
  responsibility of the power-management flow, not this controller.

compatible: "nxp,sleepcon-wuc"

include: [base.yaml, wuc-controller.yaml]

properties:
  reg:
    required: true

  '#wakeup-ctrl-cells':
    type: int
    const: 1
    description: |
      Number of cells in wakeup-ctrls property.

wakeup-ctrl-cells:
  - id
```

## subsys/cpu_workload/Kconfig
```kconfig
# Copyright 2026 NXP
#
# SPDX-License-Identifier: Apache-2.0

menuconfig CPU_WORKLOAD
	bool "CPU Workload"
	select EXPERIMENTAL
	help
	  CPU workload subsystem. It collects runtime, scheduling, and workqueue
	  activity, then exposes interpretable CPU work signals for recent, queued,
	  and expected work.

if CPU_WORKLOAD

module = CPU_WORKLOAD
module-str = CPU Workload
source "subsys/logging/Kconfig.template.log_config"

endif # CPU_WORKLOAD
```

## subsys/ebpf/Kconfig
```kconfig
# SPDX-FileCopyrightText: Copyright 2026 NXP
# SPDX-License-Identifier: Apache-2.0

menuconfig EBPF
	bool "eBPF (extended Berkeley Packet Filter) subsystem"
	help
	  Enable the eBPF subsystem for kernel observability.
	  Provides a lightweight bytecode interpreter with backend-aware
	  attach targets for runtime-programmable kernel instrumentation.

if EBPF

config EBPF_INIT_PRIORITY
	int "eBPF core initialization priority"
	default 50
	help
	  Initialization priority for the eBPF core subsystem (maps, runtime).
	  This runs at POST_KERNEL level and must complete before any backend
	  initialization so that maps and runtime state are ready.

config EBPF_BACKEND_INIT_PRIORITY
	int "eBPF backend initialization priority"
	default 51
	help
	  Initialization priority for eBPF backends (PM notifier, etc.).
	  This runs at POST_KERNEL level and must be numerically higher than
	  EBPF_INIT_PRIORITY so that the core subsystem is ready first.

config EBPF_STACK_SIZE
	int "Per-program stack size (bytes)"
	default 512
	range 128 4096
	help
	  Size of the stack available to each eBPF program invocation.
	  The VM context (stack + registers + PC) is allocated on the calling
	  thread's kernel stack.  With the default value of 512 the total
	  frame overhead is approximately 600 bytes.  Threads or ISRs that
	  execute eBPF programs must have sufficient stack headroom to
	  accommodate this allocation.  Increase the thread stack size
	  accordingly when raising this value.

config EBPF_MAX_PROG_INSNS
	int "Maximum instructions per program"
	default 4096
	range 64 65536
	help
	  Maximum number of instructions allowed in a single eBPF program.
	  Programs exceeding this limit will fail verification.

config EBPF_MAX_INSNS_PER_RUN
	int "Maximum instructions executed per invocation"
	default 4096
	range 256 65536
	help
	  Safety limit on the number of instructions executed in a single
	  eBPF program run. Prevents infinite loops.

config EBPF_MAX_ATTACHMENTS_PER_TARGET
	int "Maximum enabled attachments per hook target"
	default 8
	range 1 64
	help
	  Maximum number of eBPF programs that may be enabled on one concrete
	  attachment target at the same time.
	  The target runtime keeps two immutable dispatch snapshots per target,
	  each sized for this number of enabled attachments.
	  Increase this if many programs must fan out from the same hook.

config EBPF_LOADER
	bool "Experimental runtime eBPF loader"
	default y
	select CRC
	help
	  Enable the experimental runtime loader for serialized eBPF probe
	  objects. The loader can parse a small in-memory probe image,
	  resolve stable hook names, instantiate runtime bundle-owned maps and
	  attachments, and auto-unload the bundle after a configured TTL.

config EBPF_LOADER_AUTH_ECDSA_P256
	bool "Verify signed runtime bundles with ECDSA P-256"
	depends on EBPF_LOADER
	select PSA_CRYPTO
	select PSA_WANT_KEY_TYPE_ECC_PUBLIC_KEY
	select PSA_WANT_ALG_ECDSA
	select PSA_WANT_ECC_SECP_R1_256
	select PSA_WANT_ALG_SHA_256
	help
	  Enable verification of runtime bundle images authenticated with an
	  ECDSA P-256 signature over a SHA-256 digest of the signed image
	  region.

config EBPF_LOADER_ECDSA_P256_PUBKEY_HEX
	string "Pinned ECDSA P-256 public key"
	depends on EBPF_LOADER_AUTH_ECDSA_P256
	help
	  Uncompressed SEC1 public key encoded as 130 hexadecimal characters.
	  The first byte must be 04, followed by 32-byte X and Y coordinates.

config EBPF_MAP_ARRAY
	bool "Array map support"
	default y
	depends on EBPF
	help
	  Enable the array map type for eBPF programs.
	  Array maps are always available as a basic requirement.

config EBPF_TRACING
	bool "eBPF tracing integration"
	default y if TRACING_USER
	depends on TRACING_USER
	select INSTRUMENT_THREAD_SWITCHING
	help
	  Integrate eBPF programs with the Zephyr tracing subsystem.
	  This enables attaching eBPF programs to tracing hooks such as
	  context switches, ISR entry and exit, and idle entry and exit.
	  The backend is implemented through Zephyr tracing user callbacks.
	  This requires CONFIG_TRACING=y and CONFIG_TRACING_USER=y.

config EBPF_PM
	bool "eBPF PM notifier integration"
	default y if PM
	depends on PM
	help
	  Integrate eBPF programs with the Zephyr power-management notifier API.
	  This enables attaching eBPF programs to PM state entry and exit events.

module = EBPF
module-str = ebpf
module-help = Sets log level for eBPF subsystem
source "subsys/logging/Kconfig.template.log_config"

endif # EBPF
```

## subsys/mgmt/mcumgr/grp/ebpf_mgmt/Kconfig
```kconfig
# Copyright (c) 2026 NXP
# SPDX-License-Identifier: Apache-2.0

menuconfig MCUMGR_GRP_EBPF
	bool "Zephyr eBPF management group"
	depends on EBPF && EBPF_LOADER
	select MCUMGR_SMP_CBOR_MIN_DECODING_LEVEL_2
	select MCUMGR_SMP_CBOR_MIN_ENCODING_LEVEL_3 if ZCBOR_CANONICAL
	help
	  Enables MCUmgr commands for staged runtime bundle upload plus enable,
	  disable, unload, and dump operations on Zephyr eBPF loader bundles.

if MCUMGR_GRP_EBPF

config MCUMGR_GRP_EBPF_UPLOAD_MAX_SIZE
	int "Maximum staged eBPF bundle upload size"
	default 8192
	range 256 1048576
	help
	  Maximum runtime bundle size, in bytes, accepted through the MCUmgr
	  eBPF load command.

config MCUMGR_GRP_EBPF_MAP_READ_MAX_SIZE
	int "Maximum map value size returned by the eBPF map-read command"
	default 256
	range 1 4096
	help
	  Maximum number of bytes the MCUmgr eBPF map-read command will return
	  for one map value. Larger values are rejected to keep responses bounded.

module = MCUMGR_GRP_EBPF
module-str = mcumgr_grp_ebpf
source "subsys/logging/Kconfig.template.log_config"

endif
```

## tests/drivers/watchdog/mcux_wwdt_pm/Kconfig
```kconfig
# SPDX-FileCopyrightText: Copyright 2026 NXP
# SPDX-License-Identifier: Apache-2.0

source "Kconfig.zephyr"

config TEST_WWDT_MCX
	bool "Exercise MCXN-specific power management"
	default y

config TEST_PROVIDE_PM_HOOKS
	bool
	default y
	select HAS_PM
```
