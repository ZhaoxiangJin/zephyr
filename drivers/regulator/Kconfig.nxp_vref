## drivers/regulator/Kconfig.nxp_vref
```kconfig
# Copyright 2023 NXP
# SPDX-License-Identifier: Apache-2.0

config REGULATOR_NXP_VREF
	bool "NXP VREF peripheral driver"
	default y
	depends on DT_HAS_NXP_VREF_ENABLED
	help
	  Enable the NXP VREF driver. With device runtime PM, the first
	  regulator enable holds a runtime reference until the last disable.
	  Configuration operations temporarily resume the register block
	  without enabling the output.
	  With PM_POLICY_DEVICE_CONSTRAINTS enabled, an active output holds
	  the power-state constraints described by devicetree.

config REGULATOR_NXP_VREF_INIT_PRIORITY
	int "NXP VREF peripheral driver init priority"
	default 45
	depends on DT_HAS_NXP_VREF_ENABLED
	help
	  Init priority for the NXP VREF peripheral.
```
