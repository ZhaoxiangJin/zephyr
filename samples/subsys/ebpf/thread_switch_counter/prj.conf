## CMakeLists.txt
```
# SPDX-FileCopyrightText: Copyright 2026 NXP
# SPDX-License-Identifier: Apache-2.0

cmake_minimum_required(VERSION 3.20.0)
find_package(Zephyr REQUIRED HINTS $ENV{ZEPHYR_BASE})
project(ebpf_thread_switch_counter)

if(WEST STREQUAL "WEST-NOTFOUND")
  message(FATAL_ERROR "The eBPF thread-switch counter sample requires west to build the probe bundle")
endif()

set(gen_dir ${ZEPHYR_BINARY_DIR}/include/generated)
set(probe_src ${CMAKE_CURRENT_SOURCE_DIR}/probe/thread_switch_counter.c)
set(probe_bundle ${PROJECT_BINARY_DIR}/thread_switch_counter.bundle)
set(probe_bundle_inc ${gen_dir}/thread_switch_counter.bundle.inc)

add_custom_command(
  OUTPUT ${probe_bundle}
  COMMAND ${WEST} ebpf build ${probe_src} -o ${probe_bundle}
  --bundle-name thread_switch_probe
  DEPENDS
  ${probe_src}
  ${ZEPHYR_BASE}/scripts/west_commands/ebpf.py
  ${ZEPHYR_BASE}/include/zephyr/ebpf/ebpf_helpers.h
  ${ZEPHYR_BASE}/include/zephyr/ebpf/ebpf_map.h
  ${ZEPHYR_BASE}/include/zephyr/ebpf/ebpf_prog.h
  WORKING_DIRECTORY ${CMAKE_CURRENT_SOURCE_DIR}
  COMMENT "Building thread-switch counter eBPF probe bundle"
  VERBATIM
)

generate_inc_file_for_target(app ${probe_bundle} ${probe_bundle_inc})

target_sources(app PRIVATE src/main.c)
```

## sample.yaml
```
# SPDX-FileCopyrightText: Copyright 2026 NXP
# SPDX-License-Identifier: Apache-2.0

sample:
  name: eBPF Thread Switch Counter
  description: >
    Build a restricted-C eBPF probe bundle on the host, embed it into the
    application image, then count scheduler thread-switch events through the
    runtime loader at run time.

common:
  platform_allow:
    - native_sim
    - qemu_x86
  tags: ebpf loader tracing

tests:
  sample.ebpf.thread_switch_counter:
    integration_platforms:
      - qemu_x86
    platform_allow:
      - qemu_x86
    harness: console
    harness_config:
      type: one_line
      regex:
        - 'Thread-switch counter sample complete\.'
    tags: ebpf loader tracing
```

## prj.conf
```kconfig
# SPDX-FileCopyrightText: Copyright 2026 NXP
# SPDX-License-Identifier: Apache-2.0

CONFIG_EBPF=y
CONFIG_EBPF_LOADER=y
CONFIG_EBPF_TRACING=y
CONFIG_TRACING=y
CONFIG_TRACING_USER=y
CONFIG_HEAP_MEM_POOL_SIZE=8192
CONFIG_MAIN_STACK_SIZE=3072
CONFIG_IDLE_STACK_SIZE=1024
```

## src/main.c
```c
/*
 * SPDX-FileCopyrightText: Copyright 2026 NXP
 *
 * SPDX-License-Identifier: Apache-2.0
 */

/**
 * @file
 * @brief Thread-switch counter eBPF sample.
 *
 * Builds a restricted-C probe bundle at host build time, embeds it into the
 * application image, then loads and enables that bundle through the runtime
 * loader. The loaded probe counts thread-switch events through the stable hook
 * ``kernel/thread_switched_in``.
 */

#include <stdbool.h>
#include <stdint.h>

#include <zephyr/kernel.h>
#include <zephyr/sys/printk.h>

#include <zephyr/ebpf/ebpf_loader.h>

static const uint8_t thread_switch_probe_bundle[] = {
#include "thread_switch_counter.bundle.inc"
};

#define WORKER_STACK_SIZE 1024
#define WORKER_PRIORITY   7
#define SAMPLE_SECONDS    5
#define WORKER_SLEEP_MS   1

static K_THREAD_STACK_DEFINE(worker_a_stack, WORKER_STACK_SIZE);
static struct k_thread worker_a;
static volatile bool workers_should_run = true;

static void sample_worker(void *arg0, void *arg1, void *arg2)
{
	ARG_UNUSED(arg0);
	ARG_UNUSED(arg1);
	ARG_UNUSED(arg2);

	while (workers_should_run) {
		k_msleep(WORKER_SLEEP_MS);
	}
}

int main(void)
{
	struct ebpf_loader_handle *handle;
	uint32_t key = 0U;
	uint32_t previous_count = 0U;
	int ret;

	printk("eBPF thread-switch counter\n");
	printk("==========================\n\n");

	ret = ebpf_loader_load(thread_switch_probe_bundle,
			       sizeof(thread_switch_probe_bundle), &handle);
	if (ret != 0) {
		printk("Failed to load runtime bundle: %d\n", ret);
		return ret;
	}

	ret = ebpf_loader_enable(handle);
	if (ret != 0) {
		printk("Failed to enable runtime bundle: %d\n", ret);
		(void)ebpf_loader_unload(handle);
		return ret;
	}

	printk("Loaded bundle: %s\n", ebpf_loader_name(handle));
	printk("Runtime-loaded probe enabled.\n");

	k_thread_create(&worker_a, worker_a_stack, WORKER_STACK_SIZE,
			sample_worker, NULL, NULL, NULL,
			WORKER_PRIORITY, 0, K_NO_WAIT);

	for (int second = 0; second < SAMPLE_SECONDS; second++) {
		uint32_t current_count;

		k_sleep(K_SECONDS(1));

		ret = ebpf_loader_map_lookup_copy(handle, "counter_map",
						  &key, &current_count,
						  sizeof(current_count));
		if (ret != 0) {
			printk("Runtime map lookup failed: %d\n", ret);
			workers_should_run = false;
			break;
		}

		printk("[%d] thread_switched_in count=%u (+%u)\n",
			second + 1, current_count,
			current_count - previous_count);
		previous_count = current_count;
	}

	workers_should_run = false;
	k_thread_abort(&worker_a);

	ret = ebpf_loader_disable(handle);
	if (ret != 0) {
		printk("Failed to disable runtime bundle: %d\n", ret);
		return ret;
	}

	ret = ebpf_loader_unload(handle);
	if (ret != 0) {
		printk("Failed to unload runtime bundle: %d\n", ret);
		return ret;
	}

	printk("Runtime-loaded bundle unloaded.\n");
	printk("Thread-switch counter sample complete.\n");

	return 0;
}
```
