## CMakeLists.txt
```
# SPDX-FileCopyrightText: Copyright 2026 NXP
# SPDX-License-Identifier: Apache-2.0

cmake_minimum_required(VERSION 3.20.0)
find_package(Zephyr REQUIRED HINTS $ENV{ZEPHYR_BASE})
project(ebpf_thread_switch_counter_mcumgr)

target_sources(app PRIVATE src/main.c)
```

## sample.yaml
```
# SPDX-FileCopyrightText: Copyright 2026 NXP
# SPDX-License-Identifier: Apache-2.0

sample:
  name: eBPF Thread Switch Counter over MCUmgr
  description: >
    Run a target application that generates thread-switch activity while the
    Zephyr MCUmgr eBPF group loads runtime probes and reads their map values
    remotely.

common:
  platform_allow:
    - frdm_mcxa156
  tags: ebpf loader tracing mcumgr uart
  build_only: true

tests:
  sample.ebpf.thread_switch_counter_mcumgr:
    integration_platforms:
      - frdm_mcxa156
    platform_allow:
      - frdm_mcxa156
    build_only: true
    tags: ebpf loader tracing mcumgr uart
```

## prj.conf
```kconfig
# SPDX-FileCopyrightText: Copyright 2026 NXP
# SPDX-License-Identifier: Apache-2.0

CONFIG_EBPF=y
CONFIG_EBPF_LOADER=y
CONFIG_EBPF_TRACING=y
CONFIG_TRACING=y
CONFIG_TRACING_USER=y

CONFIG_NET_BUF=y
CONFIG_ZCBOR=y

CONFIG_MCUMGR=y
CONFIG_MCUMGR_GRP_EBPF=y
CONFIG_UART_MCUMGR=y
CONFIG_MCUMGR_TRANSPORT_UART=y
CONFIG_BASE64=y
CONFIG_CRC=y

CONFIG_CONSOLE=y
CONFIG_UART_CONSOLE=y

CONFIG_HEAP_MEM_POOL_SIZE=16384
CONFIG_MAIN_STACK_SIZE=3072
CONFIG_SYSTEM_WORKQUEUE_STACK_SIZE=3072
CONFIG_IDLE_STACK_SIZE=1024
```

## src/main.c
```c
/*
 * SPDX-FileCopyrightText: Copyright 2026 NXP
 *
 * SPDX-License-Identifier: Apache-2.0
 */

/**
 * @file
 * @brief Thread-switch counter sample driven by remote MCUmgr bundle delivery.
 */

#include <zephyr/kernel.h>
#include <zephyr/sys/printk.h>

#define WORKER_STACK_SIZE  1024
#define WORKER_PRIORITY    7
#define WORKER_SLEEP_MS    1

static K_THREAD_STACK_DEFINE(worker_stack, WORKER_STACK_SIZE);
static struct k_thread worker_thread;

static void sample_worker(void *arg0, void *arg1, void *arg2)
{
	ARG_UNUSED(arg0);
	ARG_UNUSED(arg1);
	ARG_UNUSED(arg2);

	while (true) {
		k_msleep(WORKER_SLEEP_MS);
	}
}

int main(void)
{
	printk("eBPF thread-switch counter over MCUmgr\n");
	printk("====================================\n\n");
	printk("This firmware only generates thread-switch activity.\n");
	printk("Use the MCUmgr eBPF group to load probes and read maps remotely.\n\n");

	k_thread_create(&worker_thread, worker_stack, WORKER_STACK_SIZE,
			sample_worker, NULL, NULL, NULL,
			WORKER_PRIORITY, 0, K_NO_WAIT);

	while (true) {
		k_sleep(K_SECONDS(1));
	}

	return 0;
}
```
